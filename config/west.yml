## config/west.yml
```yaml
manifest:
  remotes:
    - name: zmkfirmware
      url-base: zmkfirmware/zmk
  projects:
    - name: zmk
      remote: zmkfirmware
      revision: main
      import: app/west.yml
  self:
    path: config
```
